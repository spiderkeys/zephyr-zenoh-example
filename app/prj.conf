## CMakeLists.txt
```
cmake_minimum_required(VERSION 3.20.0)

# Dependencies
find_package(Zephyr REQUIRED HINTS $ENV{ZEPHYR_BASE})
project(app)

# Include
target_include_directories( app 
PRIVATE 
    ${CMAKE_BINARY_DIR}/app/include
    src
)

# Source
target_sources( app 
PRIVATE 
    src/main.c
)

# Dependencies
target_link_libraries( app 
PRIVATE 
    zenoh-pico 
)
```

## Kconfig
```
menu "Zephyr"
source "Kconfig.zephyr"
endmenu

module = APP
module-str = APP

config ZENOH_ROUTER_LOCATOR
	string "Zenoh Router Locator"
	default "udp/fd10:9b50:100e:0:1e34:1a03:78b8:923b:7474"
	help
	  A valid locator for a zenohd service. [udp/tcp]/[ipv4/ipv6 addr]:[port]
```

## prj.conf
```kconfig
# Kernel options
CONFIG_MAIN_STACK_SIZE=2048
CONFIG_ENTROPY_GENERATOR=y
CONFIG_TEST_RANDOM_GENERATOR=y
CONFIG_INIT_STACKS=y

# Generic library options
CONFIG_NEWLIB_LIBC=y
CONFIG_POSIX_API=y
CONFIG_MAX_PTHREAD_COUNT=4

# Logging
CONFIG_LOG=y
CONFIG_LOG_STRDUP_MAX_STRING=128
CONFIG_LOG_STRDUP_BUF_COUNT=8
CONFIG_LOG_PROCESS_THREAD_SLEEP_MS=50
CONFIG_NET_LOG=y
CONFIG_NET_STATISTICS=y
CONFIG_PRINTK=y

# Generic networking options
CONFIG_NETWORKING=y
CONFIG_NET_IPV4=n
CONFIG_NET_IPV6=y
CONFIG_NET_TCP=y
CONFIG_NET_ARP=y
CONFIG_NET_UDP=y
CONFIG_NET_DHCPV4=n
CONFIG_NET_SHELL=y
CONFIG_NET_MGMT=y
CONFIG_NET_MGMT_EVENT=y

# Sockets
CONFIG_NET_SOCKETS=y
CONFIG_NET_SOCKETS_POSIX_NAMES=y
CONFIG_NET_SOCKETS_POLL_MAX=4

# Network driver config
CONFIG_TEST_RANDOM_GENERATOR=y
CONFIG_INIT_STACKS=y

# Network buffers
CONFIG_NET_PKT_RX_COUNT=16
CONFIG_NET_PKT_TX_COUNT=16
CONFIG_NET_BUF_RX_COUNT=80
CONFIG_NET_BUF_TX_COUNT=80
CONFIG_NET_CONTEXT_NET_PKT_POOL=y

# Network address config
CONFIG_NET_CONFIG_SETTINGS=y
CONFIG_NET_CONFIG_NEED_IPV4=n
CONFIG_NET_CONFIG_NEED_IPV6=y
CONFIG_NET_IPV6_NBR_CACHE=n
CONFIG_NET_IPV6_MLD=n

# mbedTLS options
CONFIG_MBEDTLS_SSL_MAX_CONTENT_LEN=768

# IP address options
CONFIG_NET_IF_UNICAST_IPV6_ADDR_COUNT=3
CONFIG_NET_IF_MCAST_IPV6_ADDR_COUNT=4
CONFIG_NET_MAX_CONTEXTS=10

# Openthread options
CONFIG_NET_L2_OPENTHREAD=y
CONFIG_OPENTHREAD_DEBUG=y
CONFIG_OPENTHREAD_L2_DEBUG=y
CONFIG_OPENTHREAD_L2_LOG_LEVEL_INF=y

CONFIG_OPENTHREAD_JOINER=y
CONFIG_OPENTHREAD_JOINER_AUTOSTART=y
CONFIG_OPENTHREAD_NETWORK_NAME="Zenoh-Net"
CONFIG_OPENTHREAD_CHANNEL=24
CONFIG_OPENTHREAD_XPANID="10:9B:50:10:0E:62:0D:10"
CONFIG_OPENTHREAD_PANID=50665
CONFIG_OPENTHREAD_NETWORKKEY="00:01:02:03:04:05:06:07:08:09:0a:0b:0c:0d:0e:0f"
CONFIG_OPENTHREAD_SHELL=y
CONFIG_SHELL_STACK_SIZE=3072

# Zenoh-Pico
CONFIG_ZENOH_PICO=y
```

## src/main.c
```c
#include <zephyr.h>

#include <stdio.h>
#include <stdlib.h>
#include <unistd.h>

#include <logging/log.h>
#include <zenoh-pico.h>

#define LOG_MODULE_NAME app
LOG_MODULE_REGISTER(LOG_MODULE_NAME, LOG_LEVEL_DBG);

void data_handler(const zn_sample_t *sample, const void *arg)
{
    (void)arg;

    LOG_INF(">> [Subscription listener] Received msg" );
}

void main(void)
{
    LOG_INF( "Starting Openthread with config:" );
    LOG_INF( "Network Name: %s", log_strdup(CONFIG_OPENTHREAD_NETWORK_NAME) );
    LOG_INF( "Channel: %d", CONFIG_OPENTHREAD_CHANNEL );
    LOG_INF( "PANID: %d", CONFIG_OPENTHREAD_PANID );
    LOG_INF( "XPANID: %s", log_strdup(CONFIG_OPENTHREAD_XPANID) );
    LOG_INF( "Network Key: %s", log_strdup(CONFIG_OPENTHREAD_NETWORKKEY) );

    sleep( 5 );

    char *zenoh_uri = "/demo/example/**";
    zn_properties_t *config = zn_config_default();
    zn_properties_insert(config, ZN_CONFIG_PEER_KEY, z_string_make( CONFIG_ZENOH_ROUTER_LOCATOR ) );

    zn_session_t *s = NULL;
    while( s == NULL )
    {
        LOG_INF( "Connecting to zenohd at: %s", log_strdup( CONFIG_ZENOH_ROUTER_LOCATOR ) );
        s = zn_open(config);

        if (s == 0)
        {
            LOG_INF("Unable to open zenoh session!");
            sleep( 3 );
            continue;
        }

        LOG_INF( "Connected!" );
    }
    
    // Start the read session session lease loops
    int rez = znp_start_read_task(s);
    if( rez == 0 )
    {
        LOG_INF( "Started read task" );
    }
    else{
        LOG_ERR( "Failed read task %d", rez );
    }
    znp_start_lease_task(s);

    zn_subscriber_t *sub = zn_declare_subscriber(s, zn_rname( zenoh_uri ), zn_subinfo_default(), data_handler, NULL );
    if (sub == 0)
    {
        LOG_ERR("Unable to declare subscriber.");
        
    }

    LOG_INF("Awaiting data"); 
    while( true )
    {
        sleep( 1 );
    }

    zn_undeclare_subscriber(sub);
    zn_close(s);

    return;    
}
```
