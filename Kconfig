## modules/zenoh-pico/Kconfig
```kconfig
config ZEPHYR_ZENOH-PICO_MODULE
	bool

menuconfig ZENOH_PICO
	bool "Zenoh-pico Support"
	select POSIX_API
	help
	  This option enables the Zenoh-Pico library.

if ZENOH_PICO

config APP_LINK_WITH_ZENOH_PICO
    bool "Link application with Zenoh-Pico"
    default y
    help
      Request Zephyr to link the Zenoh-Pico library with the application.

endif # ZENOH
```

## west.yml
```yaml
manifest:
  self:
    path: zephyr-zenoh-example

  remotes:
    - name: zephyrproject-rtos
      url-base: https://github.com/zephyrproject-rtos
    - name: zenoh-pico
      url-base: https://github.com/spiderkeys

  projects:
    - name: zephyr
      remote: zephyrproject-rtos
      revision: zephyr-v2.7.0
      import: true
    - name: zenoh-pico
      remote: zenoh-pico
      revision: master
      path: modules/lib/zenoh-pico
```
